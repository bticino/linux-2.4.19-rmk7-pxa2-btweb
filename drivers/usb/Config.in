## drivers/usb/Config.in
```kconfig
#
# USB device configuration
#
mainmenu_option next_comment
comment 'USB support'

# ARM SA1111 chips have a non-PCI based "OHCI-compatible" USB host interface.
if [ "$CONFIG_PCI" = "y" -o "$CONFIG_SA1111" = "y" -o "$CONFIG_ARCH_PXA" = "y" ]; then
   tristate 'Support for USB' CONFIG_USB
else
   define_bool CONFIG_USB n
fi

if [ "$CONFIG_USB" = "y" -o  "$CONFIG_USB" = "m" ]; then
   bool '  USB verbose debug messages' CONFIG_USB_DEBUG

   comment 'Miscellaneous USB options'
   bool '  Preliminary USB device filesystem' CONFIG_USB_DEVICEFS
   if [ "$CONFIG_EXPERIMENTAL" = "y" ]; then
      bool '  Enforce USB bandwidth allocation (EXPERIMENTAL)' CONFIG_USB_BANDWIDTH
   else
      define_bool CONFIG_USB_BANDWIDTH n
   fi
   bool '  Long timeout for slow-responding devices (some MGE Ellipse UPSes)' CONFIG_USB_LONG_TIMEOUT

   comment 'USB Host Controller Drivers'
   source drivers/usb/hcd/Config.in
   if [ "$CONFIG_USB_UHCI_ALT" != "y" ]; then
      dep_tristate '  UHCI (Intel PIIX4, VIA, ...) support' CONFIG_USB_UHCI $CONFIG_USB
   fi
   if [ "$CONFIG_USB_UHCI" != "y" ]; then
      dep_tristate '  UHCI Alternate Driver (JE) support' CONFIG_USB_UHCI_ALT $CONFIG_USB
   else
      define_bool CONFIG_USB_UHCI_ALT n
   fi
   dep_tristate '  OHCI (Compaq, iMacs, OPTi, SiS, ALi, ...) support' CONFIG_USB_OHCI $CONFIG_USB
   dep_tristate '  isp1161 (Philips) support' CONFIG_USB_ISP116x $CONFIG_USB
      if [ "$CONFIG_USB_ISP116x" != "n"  ]; then
         choice '    hc base I/0, Physical, Virtual' \
                "IO-space CONFIG_USB_ISP116x_HC_IO \
                 Physical  CONFIG_USB_ISP116x_HC_PHYS \
                 Virtual   CONFIG_USB_ISP116x_HC_VIRT " IO-space
         if [ "$CONFIG_USB_ISP116x_HC_IO" = "y" ] ; then
            hex '    hc base' CONFIG_USB_ISP116x_HC_IO_BASE 290
         else
            if [ "$CONFIG_USB_ISP116x_HC_PHYS" = "y" ] ; then
               hex '    hc base' CONFIG_USB_ISP116x_HC_PHYS_BASE 10000000
            else
               if [ "$CONFIG_USB_ISP116x_HC_VIRT" = "y" ] ; then
                  hex '    hc base' CONFIG_USB_ISP116x_HC_VIRT_BASE ffa00000
               fi
            fi
         fi

         choice '    hc register index/ register access delay' \
                "IO-space CONFIG_USB_ISP116x_MEM_FENCE_IO \
                 Physical  CONFIG_USB_ISP116x_MEM_FENCE_PHYS \
                 Virtual   CONFIG_USB_ISP116x_MEM_FENCE_VIRT \
                 None      CONFIG_USB_ISP116x_MEM_FENCE_NONE \
                 Memory    CONFIG_USB_ISP116x_MEM_FENCE_MEMORY \
                 uDelay    CONFIG_USB_ISP116x_MEM_FENCE_UDELAY " uDelay
         if [ "$CONFIG_USB_ISP116x_MEM_FENCE_IO" = "y" ] ; then
            hex '    mem fence base' CONFIG_USB_ISP116x_MEM_FENCE_IO_BASE 240
            int '           access count' CONFIG_USB_ISP116x_MEM_FENCE_IO_ACCESS_COUNT 1
         else
            if [ "$CONFIG_USB_ISP116x_MEM_FENCE_PHYS" = "y" ] ; then
               hex '    mem fence base' CONFIG_USB_ISP116x_MEM_FENCE_PHYS_BASE 14000000
               int '           access count' CONFIG_USB_ISP116x_MEM_FENCE_PHYS_ACCESS_COUNT 2
            else
               if [ "$CONFIG_USB_ISP116x_MEM_FENCE_VIRT" = "y" ] ; then
                  hex '    mem fence base' CONFIG_USB_ISP116x_MEM_FENCE_VIRT_BASE ffb00000
                  int '           access count' CONFIG_USB_ISP116x_MEM_FENCE_VIRT_ACCESS_COUNT 2
               else
                  if [ "$CONFIG_USB_ISP116x_MEM_FENCE_MEMORY" = "y" ] ; then
                     int '           access count' CONFIG_USB_ISP116x_MEM_FENCE_MEMORY_ACCESS_COUNT 10
                  fi
               fi
            fi
         fi

         choice '    wake up base I/0, Physical, Virtual' \
                "IO-space CONFIG_USB_ISP116x_WU_IO \
                 Physical  CONFIG_USB_ISP116x_WU_PHYS \
                 Virtual   CONFIG_USB_ISP116x_WU_VIRT \
                 None      CONFIG_USB_ISP116x_WU_NONE" None
         if [ "$CONFIG_USB_ISP116x_WU_IO" = "y" ] ; then
            hex '    wake up base' CONFIG_USB_ISP116x_WU_BASE 240
         else
            if [ "$CONFIG_USB_ISP116x_WU_PHYS" = "y" ] ; then
               hex '    wake up base' CONFIG_USB_ISP116x_WU_PHYS_BASE 18000000
            else
               if [ "$CONFIG_USB_ISP116x_WU_VIRT" = "y" ] ; then
                  hex '    wake up base' CONFIG_USB_ISP116x_WU_VIRT_BASE ffc00000
               fi
            fi
         fi

            int '    irq' CONFIG_USB_ISP116x_IRQ 10
      dep_mbool '    enable dma' CONFIG_USB_ISP116x_DMA $CONFIG_USB_ISP116x
      dep_mbool '      dma request active high' CONFIG_USB_ISP116x_DMA_REQ_HIGH $CONFIG_USB_ISP116x_DMA
         if [ "$CONFIG_USB_ISP116x_DMA" = "y"  ]; then
            hex '      dma physical base' CONFIG_USB_ISP116x_DMA_PHYS_BASE 08000000
         fi
      fi
      dep_mbool '    use built-in 15k resistors' CONFIG_USB_ISP116x_15KR $CONFIG_USB_ISP116x
      dep_mbool '    use level triggered interrupts' CONFIG_USB_ISP116x_LEVEL $CONFIG_USB_ISP116x
      dep_mbool '    use external over-current detection' CONFIG_USB_ISP116x_EXTERNAL_OC $CONFIG_USB_ISP116x
      dep_mbool '    no port power switching' CONFIG_USB_ISP116x_NPS $CONFIG_USB_ISP116x
   dep_tristate '  SA1111 OHCI-compatible host interface support' CONFIG_USB_OHCI_SA1111 $CONFIG_USB

   comment 'USB Device Class drivers'
   dep_tristate '  USB Audio support' CONFIG_USB_AUDIO $CONFIG_USB $CONFIG_SOUND
   dep_tristate '    EMI 2|6 USB Audio interface support' CONFIG_USB_EMI26 $CONFIG_USB_AUDIO
   dep_tristate '  USB Bluetooth support (EXPERIMENTAL)' CONFIG_USB_BLUETOOTH $CONFIG_USB $CONFIG_EXPERIMENTAL
   if [ "$CONFIG_SCSI" = "n" ]; then
      comment '  SCSI support is needed for USB Storage'
   fi
   dep_tristate '  USB Mass Storage support' CONFIG_USB_STORAGE $CONFIG_USB $CONFIG_SCSI
      dep_mbool '    USB Mass Storage verbose debug' CONFIG_USB_STORAGE_DEBUG $CONFIG_USB_STORAGE
      dep_mbool '    Datafab MDCFE-B Compact Flash Reader support' CONFIG_USB_STORAGE_DATAFAB $CONFIG_USB_STORAGE $CONFIG_EXPERIMENTAL
      dep_mbool '    Freecom USB/ATAPI Bridge support' CONFIG_USB_STORAGE_FREECOM  $CONFIG_USB_STORAGE
      dep_mbool '    ISD-200 USB/ATA Bridge support' CONFIG_USB_STORAGE_ISD200 $CONFIG_USB_STORAGE
      dep_mbool '    Microtech CompactFlash/SmartMedia support' CONFIG_USB_STORAGE_DPCM $CONFIG_USB_STORAGE
      dep_mbool '    HP CD-Writer 82xx support' CONFIG_USB_STORAGE_HP8200e $CONFIG_USB_STORAGE $CONFIG_EXPERIMENTAL
      dep_mbool '    SanDisk SDDR-09 (and other SmartMedia) support' CONFIG_USB_STORAGE_SDDR09 $CONFIG_USB_STORAGE $CONFIG_EXPERIMENTAL
      dep_mbool '    Lexar Jumpshot Compact Flash Reader' CONFIG_USB_STORAGE_JUMPSHOT $CONFIG_USB_STORAGE $CONFIG_EXPERIMENTAL
   dep_tristate '  USB Modem (CDC ACM) support' CONFIG_USB_ACM $CONFIG_USB
   dep_tristate '  USB Printer support' CONFIG_USB_PRINTER $CONFIG_USB

   comment 'USB Human Interface Devices (HID)'
   dep_tristate '  USB Human Interface Device (full HID) support' CONFIG_USB_HID $CONFIG_USB
   if [ "$CONFIG_INPUT" = "n" ]; then
      comment '    Input core support is needed for USB HID input layer or HIDBP support'
   fi
      dep_mbool '    HID input layer support' CONFIG_USB_HIDINPUT $CONFIG_INPUT $CONFIG_USB_HID
      dep_mbool '    /dev/hiddev raw HID device support' CONFIG_USB_HIDDEV $CONFIG_USB_HID
   if [ "$CONFIG_USB_HID" != "y" ]; then
      dep_tristate '  USB HIDBP Keyboard (basic) support' CONFIG_USB_KBD $CONFIG_USB $CONFIG_INPUT
      dep_tristate '  USB HIDBP Mouse (basic) support' CONFIG_USB_MOUSE $CONFIG_USB $CONFIG_INPUT
   fi
   dep_tristate '  Wacom Intuos/Graphire tablet support' CONFIG_USB_WACOM $CONFIG_USB $CONFIG_INPUT

   comment 'USB Imaging devices'
   dep_tristate '  USB Kodak DC-2xx Camera support' CONFIG_USB_DC2XX $CONFIG_USB
   dep_tristate '  USB Mustek MDC800 Digital Camera support (EXPERIMENTAL)' CONFIG_USB_MDC800 $CONFIG_USB $CONFIG_EXPERIMENTAL
   dep_tristate '  USB Scanner support' CONFIG_USB_SCANNER $CONFIG_USB
   dep_tristate '  Microtek X6USB scanner support' CONFIG_USB_MICROTEK $CONFIG_USB $CONFIG_SCSI
   dep_tristate '  HP53xx USB scanner support (EXPERIMENTAL)' CONFIG_USB_HPUSBSCSI $CONFIG_USB $CONFIG_SCSI $CONFIG_EXPERIMENTAL

   comment 'USB Multimedia devices'
   if [ "$CONFIG_VIDEO_DEV" = "n" ]; then
      comment '  Video4Linux support is needed for USB Multimedia device support'
   else
      dep_tristate '  USB IBM (Xirlink) C-it Camera support' CONFIG_USB_IBMCAM $CONFIG_USB $CONFIG_VIDEO_DEV
      dep_tristate '  USB OV511 Camera support' CONFIG_USB_OV511 $CONFIG_USB $CONFIG_VIDEO_DEV
      dep_tristate '  USB Philips Cameras' CONFIG_USB_PWC $CONFIG_USB $CONFIG_VIDEO_DEV
      dep_tristate '  USB Logitech Quickcam Camera support' CONFIG_USB_QC $CONFIG_USB $CONFIG_VIDEO_DEV
      dep_tristate '  USB SE401 Camera support' CONFIG_USB_SE401 $CONFIG_USB $CONFIG_VIDEO_DEV
      dep_tristate '  USB STV680 (Pencam) Camera support' CONFIG_USB_STV680 $CONFIG_USB $CONFIG_VIDEO_DEV
      dep_tristate '  USB 3com HomeConnect (aka vicam) support (EXPERIMENTAL)' CONFIG_USB_VICAM $CONFIG_USB $CONFIG_VIDEO_DEV $CONFIG_EXPERIMENTAL
      dep_tristate '  D-Link USB FM radio support (EXPERIMENTAL)' CONFIG_USB_DSBR $CONFIG_USB $CONFIG_VIDEO_DEV $CONFIG_EXPERIMENTAL
      dep_tristate '  DABUSB driver' CONFIG_USB_DABUSB $CONFIG_USB
   fi

   comment 'USB Network adaptors'
   if [ "$CONFIG_NET" = "n" ]; then
      comment '  Networking support is needed for USB Networking device support'
   else
      dep_tristate '  USB Pegasus/Pegasus-II based ethernet device support (EXPERIMENTAL)' CONFIG_USB_PEGASUS $CONFIG_USB $CONFIG_NET $CONFIG_EXPERIMENTAL
      dep_tristate '  USB Realtek RTL8150 based ethernet device support (EXPERIMENTAL)' CONFIG_USB_RTL8150 $CONFIG_USB $CONFIG_NET $CONFIG_EXPERIMENTAL
      dep_tristate '  USB KLSI KL5USB101-based ethernet device support (EXPERIMENTAL)' CONFIG_USB_KAWETH $CONFIG_USB $CONFIG_NET $CONFIG_EXPERIMENTAL
      dep_tristate '  USB CATC NetMate-based Ethernet device support (EXPERIMENTAL)' CONFIG_USB_CATC $CONFIG_USB $CONFIG_NET $CONFIG_EXPERIMENTAL
      dep_tristate '  USB Communication Class Ethernet device support (EXPERIMENTAL)' CONFIG_USB_CDCETHER $CONFIG_USB $CONFIG_NET $CONFIG_EXPERIMENTAL
      dep_tristate '  USB-to-USB Networking cable device support (EXPERIMENTAL)' CONFIG_USB_USBNET $CONFIG_USB $CONFIG_NET $CONFIG_EXPERIMENTAL
   fi

   comment 'USB port drivers'
   dep_tristate '  USS720 parport driver' CONFIG_USB_USS720 $CONFIG_USB $CONFIG_PARPORT
   source drivers/usb/serial/Config.in

   comment 'USB Miscellaneous drivers'
   dep_tristate '  USB Diamond Rio500 support (EXPERIMENTAL)' CONFIG_USB_RIO500 $CONFIG_USB $CONFIG_EXPERIMENTAL
   dep_tristate '  USB Auerswald ISDN support (EXPERIMENTAL)' CONFIG_USB_AUERSWALD $CONFIG_USB $CONFIG_EXPERIMENTAL
   dep_tristate '  Tieman Voyager USB Braille display support (EXPERIMENTAL)' CONFIG_USB_BRLVGER $CONFIG_USB $CONFIG_EXPERIMENTAL
   dep_tristate '  Buslink HD support(EXPERIMENTAL)' CONFIG_USB_USBIDE  $CONFIG_USB $CONFIG_EXPERIMENTAL
fi

source drivers/usb/gadget/Config.in

endmenu
```

## drivers/usb/gadget/Config.in
```kconfig
#
# USB device-side configuration
# for 2.4 kbuild, drivers/usb/gadget/Config.in
#
# Long term, this likely doesn't all belong in one directory
# Plan to split it up eventually.
#
mainmenu_option next_comment
comment 'Support for USB gadgets'

tristate 'Support for USB Gadgets' CONFIG_USB_GADGET
if [ "$CONFIG_USB_GADGET" = "y" -o "$CONFIG_USB_GADGET" = "m" ]; then
  
  #
  # really want _exactly one_ device controller driver at a time,
  # since they control compile options for gadget drivers.
  #
  choice 'USB Peripheral Controller Driver' "\
	Intel-PXA2xx/IXP4xx		CONFIG_USB_GADGET_PXA2XX \
	NetChip-2280			CONFIG_USB_GADGET_NET2280 \
	Renesas-SH7705/7727		CONFIG_USB_GADGET_SUPERH  \
	Toshiba-TC86C001(Goku-S)	CONFIG_USB_GADGET_GOKU \
	" NetChip-2280

  define_tristate CONFIG_USB_GADGET_CONTROLLER n

  if [ "$CONFIG_ARCH_PXA" = "y" -o "$CONFIG_ARCH_IXP425" = "y" ] ; then
     if [ "$CONFIG_USB_GADGET_PXA2XX" = "y" ] ; then
       define_tristate CONFIG_USB_PXA2XX $CONFIG_USB_GADGET
       define_tristate CONFIG_USB_GADGET_CONTROLLER $CONFIG_USB_PXA2XX
     fi
  fi
  if [ "$CONFIG_PCI" = "y" -a "$CONFIG_USB_GADGET_NET2280" = "y" ] ; then
    define_tristate CONFIG_USB_NET2280 $CONFIG_USB_GADGET
    define_tristate CONFIG_USB_GADGET_CONTROLLER $CONFIG_USB_NET2280
  fi
  if [ "$CONFIG_SUPERH" = "y" -a "$CONFIG_USB_GADGET_SUPERH" = "y" ] ; then
    define_tristate CONFIG_USB_SUPERH $CONFIG_USB_GADGET
    define_tristate CONFIG_USB_GADGET_CONTROLLER $CONFIG_USB_SUPERH
  fi
  if [ "$CONFIG_PCI" = "y" -a "$CONFIG_USB_GADGET_GOKU" = "y" ] ; then
    define_tristate CONFIG_USB_GOKU $CONFIG_USB_GADGET
    define_tristate CONFIG_USB_GADGET_CONTROLLER $CONFIG_USB_GOKU
  fi

  if [ "$CONFIG_USB_GADGET_CONTROLLER" = "y" -o "$CONFIG_USB_GADGET_CONTROLLER" = "m" ] ; then

  #
  # no reason not to enable more than one gadget driver module, but
  # for static linking that would make no sense since the usb model
  # has exactly one of these upstream connections and only one
  # lowest-level driver can control it.
  #
  # gadget drivers are compiled to work on specific hardware, since
  #
  # (a) gadget driver need hardware-specific configuration, like what
  #     endpoint names and numbers to use, maxpacket sizes, etc
  #
  # (b) specific hardware features like iso endpoints may be required
  #
  comment 'USB Gadget Drivers'

  # FIXME when drivers all use #ifdef CONFIG_USB_GADGET_* tests,
  # just remove all this driver-specific define_bool logic

  dep_tristate '  Gadget Zero (DEVELOPMENT)' CONFIG_USB_ZERO $CONFIG_USB_GADGET_CONTROLLER
  dep_tristate '  Ethernet Gadget (EXPERIMENTAL)' CONFIG_USB_ETH $CONFIG_USB_GADGET_CONTROLLER $CONFIG_NET
  dep_tristate '  Gadget Filesystem API (EXPERIMENTAL)' CONFIG_USB_GADGETFS $CONFIG_USB_GADGET_CONTROLLER
  dep_tristate '  File-backed Storage Gadget (DEVELOPMENT)' CONFIG_USB_FILE_STORAGE $CONFIG_USB_GADGET_CONTROLLER
  dep_mbool '    File-backed Storage Gadget test mode' CONFIG_USB_FILE_STORAGE_TEST $CONFIG_USB_FILE_STORAGE
  dep_tristate '  Serial Gadget (EXPERIMENTAL)' CONFIG_USB_G_SERIAL $CONFIG_USB_GADGET_CONTROLLER
  

    # enforce the "only one statically linked gadget driver" rule

    if [ "$CONFIG_USB_ZERO" = "y" ]; then
      # zero = y
      define_tristate CONFIG_USB_ETH n
      define_tristate CONFIG_USB_GADGETFS n
      define_tristate CONFIG_USB_FILE_STORAGE n
      define_tristate CONFIG_USB_G_SERIAL n
    fi

    if [ "$CONFIG_USB_ETH" = "y" ]; then
      define_tristate CONFIG_USB_ZERO n
      # eth = y
      define_tristate CONFIG_USB_GADGETFS n
      define_tristate CONFIG_USB_FILE_STORAGE n
      define_tristate CONFIG_USB_G_SERIAL n
    fi

    if [ "$CONFIG_USB_GADGETFS" = "y" ]; then
      define_tristate CONFIG_USB_ZERO n
      define_tristate CONFIG_USB_ETH n
      # gadgetfs = y
      define_tristate CONFIG_USB_FILE_STORAGE n
      define_tristate CONFIG_USB_G_SERIAL n
    fi

    if [ "$CONFIG_USB_FILE_STORAGE" = "y" ]; then
      define_tristate CONFIG_USB_ZERO n
      define_tristate CONFIG_USB_ETH n
      define_tristate CONFIG_USB_GADGETFS n
      # file_storage = y
      define_tristate CONFIG_USB_G_SERIAL n
    fi

    if [ "$CONFIG_USB_G_SERIAL" = "y" ]; then
      define_tristate CONFIG_USB_ZERO n
      define_tristate CONFIG_USB_ETH n
      define_tristate CONFIG_USB_GADGETFS n
      define_tristate CONFIG_USB_FILE_STORAGE n
      # g_serial = y
    fi
  fi
fi
endmenu
```
